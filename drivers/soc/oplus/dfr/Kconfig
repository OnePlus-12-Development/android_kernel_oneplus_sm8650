## drivers/soc/oplus/dfr/Kconfig
```kconfig
# SPDX-License-Identifier: GPL-2.0-only
# Copyright (C) 2018-2022 Oplus. All rights reserved.

#ifdef OPLUS_FEATURE_PMIC_MONITOR
source "drivers/soc/oplus/dfr/qcom/qcom_pmic_monitor/Kconfig"
#endif /* OPLUS_FEATURE_PMIC_MONITOR */
```
